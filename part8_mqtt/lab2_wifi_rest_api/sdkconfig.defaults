## part8_mqtt/lab2_wifi_rest_api/sdkconfig.defaults
```kconfig
CONFIG_ESPTOOLPY_FLASHSIZE_4MB=y
CONFIG_ESPTOOLPY_FLASHSIZE="4MB"

# Connection to WiFi Box
CONFIG_WIFI_SSID="HuaweiMate20Pro"
CONFIG_WIFI_PASSWORD="yassin19"
```
